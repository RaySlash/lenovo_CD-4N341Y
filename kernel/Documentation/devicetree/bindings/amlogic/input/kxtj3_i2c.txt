## kernel/Documentation/devicetree/bindings/amlogic/input/kxtj3_i2c.txt
```
kxtj3_2b: kxtj3_2b@2b{
	compatible = "kionix,kionix_accel";
	reg = <0x0E>;
	int-gpio = <&gpio GPIOZ_10 GPIO_ACTIVE_LOW>;
	status = "okay";
};
```

## kernel/Documentation/devicetree/bindings/amlogic/input/stk3311_i2c.txt
```
stk3311:stk3311@0x48 {
	compatible = "STK3311";
	reg = <0x48>;
	interrupt_pin = <&gpio_ao GPIOAO_8 0>;
	status = "okay";
};
```

## kernel/Documentation/devicetree/bindings/amlogic/mir3da_i2c.txt
```
mir3da: mir3da_13@13{
      compatible = "mir3da";
      reg = <0x27>;
      int-gpio = <&gpio GPIOZ_10 GPIO_ACTIVE_LOW>;
      status = "okay";
};
```

## kernel/Documentation/devicetree/bindings/amlogic/sn311_i2c.txt
```
sn3112_1: sn3112_1@54 {
	compatible = "amlogic,sn3112_1";
	reg = <0x54>;
	sdb-gpio = <&gpio GPIOZ_1 0>;
	/*sn3112-supply = <&mt6392_vcamaf_reg>;*/
};
```

## kernel/drivers/amlogic/input/sensor/Kconfig
```kconfig
menuconfig AMLOGIC_SENSOR
	bool "Sensor devices"
	---help---
	  Say Y here to get to see options for sensor device drivers from
	  all categories. This option alone does not add any kernel code.

	  If you say N,all options in this submenu will be skipped and disabled.

if AMLOGIC_SENSOR

config AMLOGIC_SENSOR_CY8C4014
	tristate "cy8c4014 sensor driver"
	depends on I2C
	default n
	help
	  Say yes here to support Cypress cy8c4014 sensor and proximity
	  sensor
	  Say yes here to support Cypress cy8c4014 sensor and proximity
	  sensor

config AMLOGIC_G_SENSOR
	tristate "KXTJ3 sensordriver"
	depends on I2C
	default n
	help
	  Say yes here to support kionix KXTJ3 accel sensor 

	  
config AMLOGIC_T_H_SENSOR
	tristate "Sensirion Humidity sensor driver"
	depends on I2C
	default n
	help
	  Say yes here to support Sensirion Humidity Sensors_SHTC3 sensor

config AMLOGIC_L_P_SENSOR
	tristate "Ambient Light sensor driver"
	depends on I2C
	default n
	help
	  Say yes here to support Ambient Light Sensor and Proximity Sensor

config AMLOGIC_SENSOR_MIR3DA
	tristate "mir3da sensor driver"
	depends on I2C
	default n
	help
	  Say yes here to support Cypress mir3da sensor and proximity
	  sensor
	  Say yes here to support Cypress mir3da sensor and proximity
	  sensor

endif # SENSOR_DEVICES
```

## kernel/drivers/amlogic/ledscreen/Kconfig
```kconfig
menuconfig AMLOGIC_LEDSCREEN
	bool "ledscreen devices"
	---help---
	  Say Y here to get to see options for sensor device drivers from
	  all categories. This option alone does not add any kernel code.

	  If you say N,all options in this submenu will be skipped and disabled.

if AMLOGIC_LEDSCREEN

config AMLOGIC_LEDSCREEN_TM1640
	tristate "ledscreen tm1640 driver"
	default n
	help
	  Say yes here to support tm1640 and proximity

config AMLOGIC_LEDSCREEN_SN3112
	tristate "ledscreen sn3112 driver"
	default n
	help
	  Say yes here to support sn3112 and proximity


endif # LEDSCREEN_DEVICES
```
